#include "StatusDisplay.h"

StatusDisplay::StatusDisplay() {
  
}

void StatusDisplay::updateOnLoop(unsigned long currentTime, unsigned long remainingBreak, float temperature, float humidity, float moisture, bool isWatering) {

  if (!onUpdateLoopIsCalled) {
    onUpdateLoopIsCalled = true;
    showDHTScreen(temperature, humidity);
    activeDisplay = 0;
    return;
  }

  if (isWatering) {
    if (activeDisplay != 3) {
      showWateringScreen();
      activeDisplay = 3;
    }
    return;
  }

  currentTime /= 1000;
  currentTime %= 10;

  if (currentTime > 5) {
    if (activeDisplay != 0) {
      showDHTScreen(temperature, humidity);
      activeDisplay = 0;
    }

  } else {
    getTime(currentTime);
    if (activeDisplay != 1) {
      showMoistureScreen(remainingBreak, moisture);
      activeDisplay = 1;
    } else if (updateTime) {
      updateSeconds(remainingBreak);
      //display -> clearDisplay();
    }
  }
}

void StatusDisplay::setup() {
  display = new Adafruit_SSD1306(128, 64, &Wire, -1);
  display->begin(SSD1306_SWITCHCAPVCC, 0x3C);
}

void StatusDisplay::showMoistureScreen(unsigned long time, float moisture) {
  display->clearDisplay();
  display->setTextColor(WHITE);
  display->setTextSize(1);
  display->setCursor(0, 0);
  display->print("Moisture: ");
  display->setTextSize(2);
  display->setCursor(0, 10);
  display->print(moisture);
  display->print(" %");

  display->setTextSize(1);
  display->setCursor(0, 35);
  display->print("Watering break: ");
  display->setTextSize(2);
  display->setCursor(0, 45);
  display->print(getTime(time));
  display->println(timeEnding);

  display->display();
}

void StatusDisplay::showDHTScreen(float t, float h) {
  display->clearDisplay();
  display->setTextColor(WHITE);
  display->setTextSize(1);
  display->setCursor(0, 0);
  display->print("Temperature: ");
  display->setTextSize(2);
  display->setCursor(0, 10);
  display->print(t);
  display->print(" ");
  display->setTextSize(1);
  display->cp437(true);
  display->write(167);
  display->setTextSize(2);
  display->print("C");
  display->setTextSize(1);
  display->setCursor(0, 35);
  display->print("Humidity: ");
  display->setTextSize(2);
  display->setCursor(0, 45);
  display->print(h);
  display->print(" %");
  display->display();
}

void StatusDisplay::updateSeconds(unsigned long time) {
  display->fillRect(0, 44, 128, 20, BLACK);
  display->setTextColor(WHITE);
  display->setTextSize(2);
  display->setCursor(0, 45);
  display->print(getTime(time));
  display->println(timeEnding);
  display->display();
}

unsigned long StatusDisplay::getTime(unsigned long time) {

  time /= 1000;
  if (time >= 3600) {
    time /= 3600;
    updateTime = time != lastTime;
    lastTime = time;
    timeEnding = " h";
    return time;

  } else if (time >= 60) {
    time /= 60;
    updateTime = time != lastTime;
    lastTime = time;
    timeEnding = " min";
    return time;
  }
  updateTime = time != lastTime;
  lastTime = time;
  timeEnding = " sec";
  return time;
}

void StatusDisplay::showWateringScreen() {
  // 'kanne2', 128x64px
  unsigned char myBitmap[] PROGMEM = {
    0x00, 0x00, 0x00, 0x00, 0x00, 0x00, 0x00, 0x00, 0x00, 0x00, 0x00, 0x00, 0x00, 0x00, 0x00, 0x00,
    0x00, 0x00, 0x00, 0x00, 0x00, 0x00, 0x00, 0x00, 0x00, 0x00, 0x00, 0x00, 0x00, 0x00, 0x00, 0x00,
    0x00, 0x00, 0x00, 0x00, 0x00, 0x00, 0x00, 0x00, 0xff, 0x80, 0x00, 0x00, 0x00, 0x00, 0x00, 0x00,
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    0x00, 0x00, 0x00, 0x00, 0x00, 0x00, 0x00, 0x00, 0x00, 0x00, 0x00, 0x00, 0x00, 0x00, 0x00, 0x00
  };
  display->clearDisplay();
  display->drawBitmap(0, 0, myBitmap, 128, 64, WHITE);
  display->display();
}
